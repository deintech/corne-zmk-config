m_s_b1: macro_stg_bluetooth_1 {
    compatible = "zmk,behavior-macro";
    #binding-cells = <0>;
    bindings =
        <&bt BT_SEL 0 &to_mBAS>;
};

m_s_b2: macro_stg_bluetooth_2 {
    compatible = "zmk,behavior-macro";
    #binding-cells = <0>;
    bindings =
        <&bt BT_SEL 1 &to_mBAS>;
};

m_s_b3: macro_stg_bluetooth_3 {
    compatible = "zmk,behavior-macro";
    #binding-cells = <0>;
    bindings =
        <&bt BT_SEL 2 &to_wBAS>;
};

m_s_b4: macro_stg_bluetooth_4 {
    compatible = "zmk,behavior-macro";
    #binding-cells = <0>;
    bindings =
        <&bt BT_SEL 3 &to_wBAS>;
};

m_s_b5: macro_stg_bluetooth_5 {
    compatible = "zmk,behavior-macro";
    #binding-cells = <0>;
    bindings =
        <&bt BT_SEL 4 &to_aBAS>;
};

m_s_b6: macro_stg_bluetooth_6 {
    compatible = "zmk,behavior-macro";
    #binding-cells = <0>;
    bindings =
        <&bt BT_SEL 5 &to_aBAS>;
};

// mp_sSTG_cb
MORPH_KAS(
    s,
    STG,
    cb,
    clear_bluetooth,
    MOD_LALT,
    &studio_unlock,   // tap:   zmk studio unlock
    &bt BT_CLR,       // alt:   clear current profile
    &bt BT_CLR_ALL    // shift: clear all profiles
)
