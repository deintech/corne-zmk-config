// tap:          zoom reset
// shift:        zoom reset vscode
mp_ma_zoom_reset: morph_mac_action_zoom_reset {
    compatible = "zmk,behavior-mod-morph";
    #binding-cells = <0>;
    mods = <(MOD_LSFT|MOD_RSFT)>;
    bindings = <&kp RG(N0)>, <&kp RG(KP_N0)>;
};

// mp_mSTG_f
MORPH_KS(
    m,
    STG,
    f,
    files,
    &kp LA(LG(SPACE)),  // tap:   finder
    &kp LS(LG(DOT))     // shift: show/hide system files
)

// mp_mSTG_screenshot
MORPH_KAS(
    m,
    STG,
    screenshot,
    screenshot,
    MOD_LALT,
    &kp RS(RG(N5)),  // tap:   screenshot and recording options
    &kp RS(RG(N4)),  // alt:   screenshot of selected area
    &kp RS(RG(N3))   // shift: screenshot of screen
)
// ctrl: adding ctrl key copy to clipboard instead of saving a file

// mp_mSTG_topleft
MORPH_KA(
    m,
    STG,
    topleft,
    topleft,
    MOD_LALT,
    &kp LS(LG(E)),              // tap:   ide: explorer
    &kp LS(LA(LG(LC(LEFT))))    // alt:   rectangle top left
)

// mp_mSTG_up
MORPH_KA(
    m,
    STG,
    up,
    up,
    MOD_LALT,
    &kp LS(LC(G)),              // tap:   ide: source control
    &kp LS(LA(LG(UP)))          // alt:   rectangle top half
)

// mp_mSTG_topright
MORPH_KA(
    m,
    STG,
    topright,
    topright,
    MOD_LALT,
    &kp LS(LG(D)),              // tap:   ide: debugger
    &kp LS(LA(LG(LC(RIGHT))))   // alt:   rectangle top right
)

// mp_mSTG_left
MORPH_KA(
    m,
    STG,
    left,
    left,
    MOD_LALT,
    &kp LG(B),                  // tap:   ide: toggle primary side bar 
    &kp LA(LG(LS(LEFT)))        // alt:   rectangle left
)

// mp_mSTG_rectangle
MORPH_KAS(
    m,
    STG,
    rectangle,
    rectangle,
    MOD_LALT,
    &kp LA(LC(F)),              // tap:   maximize
    &kp LA(LC(BACKSPACE)),      // alt:   restore
    &kp LS(LA(LC(F)))           // shift: center
)

// mp_mSTG_right
MORPH_KA(
    m,
    STG,
    right,
    right,
    MOD_LALT,
    &kp LA(LG(B)),              // tap:   ide: toggle secondary side bar 
    &kp LA(LG(LS(RIGHT)))       // alt:   rectangle right
)

// mp_mSTG_downleft
MORPH_KA(
    m,
    STG,
    downleft,
    downleft,
    MOD_LALT,
    &none,                      // tap:   none
    &kp LA(LG(LC(LEFT)))        // alt:   rectangle down left
)

// mp_mSTG_down
MORPH_KA(
    m,
    STG,
    down,
    down,
    MOD_LALT,
    &kp LG(J),                 // tap:   ide: toggle panel bottom bar 
    &kp LS(LA(LG(DOWN)))       // alt:   rectangle right
)

// mp_mSTG_downright
MORPH_KA(
    m,
    STG,
    downright,
    downright,
    MOD_LALT,
    &none,                      // tap:   none
    &kp LA(LG(LC(RIGHT)))       // alt:   rectangle down right
)

// mp_mSTG_m
MORPH_KS(
    m,
    STG,
    m,
    mute,
    &kp C_MUTE,                 // tap:   volume mute
    &kp LS(LA(LC(LG(M))))       // shift: mic mute
)
