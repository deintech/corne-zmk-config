## config/west.yml
```yaml
manifest:
  remotes:
    - name: deinsoftware
      url-base: https://github.com/deinsoftware
  projects:
    - name: zmk
      remote: deinsoftware
      revision: swept_battery
      import: app/west.yml
  self:
    path: config
```
